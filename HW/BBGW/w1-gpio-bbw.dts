
/dts-v1/;
/plugin/;

/ {
    compatible = "ti,beaglebone", "ti,beaglebone-white", "ti,am33xx";

    fragment@0 {
        target = <&am33xx_pinmux>;
        __overlay__ {
            w1_pins: pinmux_w1_pins {
                pinctrl-single,pins = <0x0a4 0x37>;  // P8_11 (GPIO 45, gpio1_13), mode 7 (GPIO), pull-up
            };
        };
    };

    fragment@1 {
        target-path = "/";
        __overlay__ {
            w1_bus {
                compatible = "w1-gpio";
                gpios = <&gpio1 13 GPIO_ACTIVE_HIGH>;  // GPIO 45
                status = "okay";
            };
        };
    };
};
